/ {
  behaviors {
    ss_cw: ss_cw {
      compatible = "zmk,behavior-tap-dance";
      label = "SS_CW";
      #binding-cells = <0>;
      tapping-term-ms = <200>;
      bindings = <&sk LSHFT>, <&caps_word>;
    };
  };
};


