/* source keypos definitions */

#include "keys/36keys.h"
/* activate bluetooth */
/* source the main keymap */
#include "base.keymap"

/* use 5-column layout for Zen */
/ { chosen { zmk,matrix_transform = &five_column_transform; }; };


/* vim: set filetype=c : */
