/ {
  behaviors {
    hml: homerow_mods_left {
      compatible = "zmk,behavior-hold-tap";
      label = "HOMEROW_MODS_LEFT";
      #binding-cells = <2>;
      bindings = <&kp>, <&kp>;
      flavor = "balanced";
      tapping-term-ms = <280>;
      require-prior-idle-ms = <150>;
      hold-trigger-key-positions = <KEYS_R KEYS_T>;
      hold-trigger-on-release;       // requires PR #1423
    };
    hmr: homerow_mods_right {
      compatible = "zmk,behavior-hold-tap";
      label = "HOMEROW_MODS_RIGHT";
      #binding-cells = <2>;
      bindings = <&kp>, <&kp>;
      flavor = "balanced";
      tapping-term-ms = <280>;
      require-prior-idle-ms = <150>;
      hold-trigger-key-positions = <KEYS_L KEYS_T>;
      hold-trigger-on-release;       // requires PR #1423
    };
  };
};
